## conf/layer.conf
```bitbake
BBPATH .= ":${LAYERDIR}"

BBFILES += "\
    ${LAYERDIR}/recipes-*/*/*.bb \
    ${LAYERDIR}/recipes-*/*/*.bbappend \
"

BBFILE_COLLECTIONS += "meta-rockchip-extra"
BBFILE_PATTERN_meta-rockchip-extra = "^${LAYERDIR}/"
BBFILE_PRIORITY_meta-rockchip-extra = "6"

LAYERDEPENDS_meta-rockchip-extra += "rockchip"

LAYERSERIES_COMPAT_meta-rockchip-extra = "scarthgap styhead"
```
